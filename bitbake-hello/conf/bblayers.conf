## bitbake-hello/conf/bblayers.conf
```bitbake
BBLAYERS ?= " \
	${TOPDIR}/meta-hl-layer \
	${TOPDIR}/meta-two \
"

include local.conf
```

## bitbake-hello/conf/local.conf
```bitbake
MACHINE  ??= "qemuarm"

DISTRO ?= "poky"

# CONF_VERSION = "2"

# TMPDIR  = "${TOPDIR}/tmp"
CACHE   = "${TMPDIR}/cache"
# STAMP   = "${TMPDIR}/stamps"
# T       = "${TMPDIR}/work"
# B       = "${TMPDIR}"
```

## bitbake-hello/meta-hl-layer/conf/layer.conf
```bitbake
BBPATH .= ":${LAYERDIR}"

BBFILES += "${LAYERDIR}/*.bb"
BBFILES += "${LAYERDIR}/recipes-*/*/*.bb"

BBFILE_COLLECTIONS += "hl-layer"
BBFILE_PATTERN_hl-layer := "^${LAYERDIR}/"

LAYERSERIES_COMPAT_hl-layer = ""
```
